#include "sys.h"
#include "delay.h"  
#include "usart.h"  
#include "led.h"
#include "key.h"
#include "lcd.h"
#include "timer.h" 
#include "math.h" 
#include "arm_math.h"  
#include "adc.h"
#include "dac.h"
#include "stdbool.h"
#include "AD9833.h"

#define xiangweizhi 0               //注释锁
#define test1       1               //任务一锁
#define meun        1               //波形里的菜单

#define FFT_LENGTH		1024 		//FFT长度，默认是1024点FFT
#define RESOLUTION 2048
float fft_inputbuf[FFT_LENGTH*2];	//FFT输入数组(一定要大于两倍FFT长度)
float fft_outputbuf[FFT_LENGTH];	//FFT输出数组
float kaiser[1024]={0.789848314825112f, 0.790619838667604f, 0.791390228324344f, 0.792159481709385f, 0.792927596739707f, 0.793694571335223f, 0.794460403418787f, 0.795225090916202f, 0.795988631756221f, 0.79675102387056f, 0.7975122651939f, 0.798272353663893f, 0.799031287221172f,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 0.790619838667604f, 0.789848314825112f};
u8 timeout;//定时器溢出次数
static char oscilloscopeLevel ;   //记录信号发生器射频大小
    
#if xiangweizhi //测试别项相位值（2）
u16   freamplen; // freamp长度的一半    
const u32  fft_sample_freq=84000000/(65535*84);  //fft采样频率 为信号的3到6倍   幅值最准确  
float freamp[50];//获取各次谐波频率和幅?   
float zhiliu1,HZ1,amp1,phase1;    
#endif
void clear_point(u16 num);//更新显示屏当前列	
void Set_BackGround(void);//设置背景
void Lcd_DrawNetwork(void);//画网格
float get_vpp(float *buf);//获取峰峰值
void DrawOscillogram(float *buf);//画波形图
void DrawSpectrum(float *buf,u32 f);//画出幅频特性图
u32 get_freq(float *buff);//得到最高频率
void Collect_ADC_LEVEL(float *buff);//采集电平
void Add_Kwindow(float *buff);//在函数上加Kaiser窗
//u32 get_arg(float *buff);   //获取相位
u32 get_arg(float *buffx,float *buffy);   //获取相位
int fft_getpeak(float *inputx,float *input,float *output,u16 inlen,u8 x,u8 N,float y); //测试获取许多东西
	
int main(void)
{ 
  arm_cfft_radix4_instance_f32 scfft;
 	u8 key,t;
    static bool isAudioDetectionMode = true;
	float Adresult = 0;
	u32 freq,arg;
    u8 arg_buff[20]={0};
	u16 i; 
	u8 Vpp_buff[20] = {0};
	u8 Freq_buff[20]={0};
    u8 show[20]={0};

    oscilloscopeLevel = 0;
	NVIC_PriorityGroupConfig(NVIC_PriorityGroup_2);//设置系统中断优先级分组2
	delay_init(168);  //初始化延时函数
	uart_init(115200);		//初始化串口波特率为115200
	//初始化：
	LED_Init();					//初始化LED
	KEY_Init();					//初始化按键
 	LCD_Init();					//初始化LCD
    AD9833_Init();              //初始化信号发生器
	Adc_Init();                 //初始化ADC
	DAC_Mode_Init();			//产生正弦波
	LCD_Display_Dir(1);	
	Set_BackGround();	        //显示背景
	Lcd_DrawNetwork();
    
    sprintf((char*)show,"test1");	
    LCD_ShowString(60,10,210,24,24,show);
    sprintf((char*)show,"test2");
    LCD_ShowString(60,40,210,24,24,show);
    sprintf((char*)show,"test3");
	LCD_ShowString(60,70,210,24,24,show);
	LED0 = 0;
	TIM3_Int_Init(65535,84-1);	//1Mhz计数频率,最大计时65ms左右超出   
	arm_cfft_radix4_init_f32(&scfft,FFT_LENGTH,0,1);//初始化scfft结构体，设定FFT相关参数
 	while(1)
	{
			key=KEY_Scan(0);            //设想按键一和二分别控制任务3输出功率
			if(key==WKUP_PRES)
			{
                oscilloscopeLevel++;
                AD9833_Square_Wave(0,10000,0,0); //2:频率 4：相位
                sprintf((char*)show,"PowerOutput%d",oscilloscopeLevel);	
                LCD_ShowString(320,10,210,24,24,show);
            }
            else if(key==KEY1_PRES)
            {
                oscilloscopeLevel--;
                AD9833_Setup(0,50000.0,0,50,1);
                sprintf((char*)show,"PowerOutput%d",oscilloscopeLevel);	
                LCD_ShowString(320,10,210,24,24,show);
            }
            
            
			if(key == KEY0_PRES)
			{	
                while(1)
                {
                   #if meun
               key=KEY_Scan(1); 
            if(key==WKUP_PRES)
			{
                oscilloscopeLevel++;
                AD9833_Square_Wave(0,10000,0,0); //2:频率 4：相位
                sprintf((char*)show,"PowerOutput%d",oscilloscopeLevel);	
                LCD_ShowString(320,10,210,24,24,show);
                
            }
            else if(key==KEY1_PRES)
            {
                oscilloscopeLevel--;
                AD9833_Setup(0,50000.0,0,50,1);
                sprintf((char*)show,"PowerOutput%d",oscilloscopeLevel);	
                LCD_ShowString(320,10,210,24,24,show);
            }
            else if(key == KEY2_PRES)          //切换音频信号隔断
           {    
               delay_ms(10);//去抖动
               while(KEY2_PRES == 1);
               isAudioDetectionMode = !isAudioDetectionMode; // 切换模式
            if(isAudioDetectionMode) {
                // 切换到音频信号检测模式 
                sprintf((char*)show,"DetectionMode:1");	
                LCD_ShowString(300,250,210,24,24,show);
           } else 
            {
                // 切换到人声检测模式
                sprintf((char*)show,"DetectionMode:0");	
                LCD_ShowString(300,250,210,24,24,show);
            }
               
           }
                   #endif


                    
                
			Collect_ADC_LEVEL(fft_inputbuf);
			//if(show_flag==1)
			DrawOscillogram(fft_inputbuf);//画波形
			Adresult = get_vpp(fft_inputbuf);//峰峰值mv
			Add_Kwindow(fft_inputbuf);
			arm_cfft_radix4_f32(&scfft,fft_inputbuf);	//FFT计算（基4）
			arm_cmplx_mag_f32(fft_inputbuf,fft_outputbuf,FFT_LENGTH);	//把运算结果复数求模得幅值 
			#if 0
            for(i=0;i<FFT_LENGTH;i++)                                   //验证幅值
			{
				printf("output:%.2f,%.2f\n",fft_inputbuf[2*i],fft_outputbuf[i]);
			} 
            #endif
			freq=get_freq(fft_outputbuf);
            #if xiangweizhi //测试别项相位值（2）
            freamplen=fft_getpeak(fft_inputbuf,fft_outputbuf+1,freamp,FFT_LENGTH/2,10,5,0.2);//寻找基波和谐波
            zhiliu1=fft_outputbuf[0]/FFT_LENGTH;//直流 
            HZ1=freamp[0];//频率
            amp1=freamp[1];//幅度
            phase1=freamp[2];//相位
            freamp[0]=0;freamp[1]=0;freamp[2]=0;	
//            printf("zhiliu1:%.2f\r\n",zhiliu1);
            printf("HZ1:%.2f\r\n",HZ1);
//            printf("amp1:%.2f\r\n",amp1);
            printf("phase1:%.2f\r\n",phase1);
            #endif
            arg = get_arg(fft_outputbuf,fft_inputbuf);
			//if(show_flag!=1)
			//DrawSpectrum(fft_outputbuf,freq);
//			Adresult =0.0281682f+2.04374f*Adresult-0.05f+0.00004f*(freq-1000);//曲线拟合结果
			POINT_COLOR = WHITE;
			BACK_COLOR = DARKBLUE;
			sprintf((char*)Freq_buff,"Fs = %dHz",freq);
			LCD_ShowString(60,10,210,24,24,Freq_buff);
            #if test1                   //任务一
            if(freq > 100)
            {

               LED0 = 0;
            }
            else LED0 = 1;
            #endif
//            printf("Freq_buff:%d\n",freq);
            
			sprintf((char*)Vpp_buff,"VPP = %0.2fV",Adresult);		
			LCD_ShowString(60,40,210,24,24,Vpp_buff);
            sprintf((char*)Vpp_buff,"arg = %d",arg);		
			LCD_ShowString(60,70,210,24,24,Vpp_buff);
		
                }
            }
                
        
        
           else if(key == KEY2_PRES)          //切换音频信号隔断
           {    
               delay_ms(10);//去抖动
               while(KEY2_PRES == 1);
               isAudioDetectionMode = !isAudioDetectionMode; // 切换模式
            if(isAudioDetectionMode) {
                // 切换到音频信号检测模式 
                sprintf((char*)show,"DetectionMode:1");	
                LCD_ShowString(300,250,210,24,24,show);
           } else 
            {
                // 切换到人声检测模式
                sprintf((char*)show,"DetectionMode:0");	
                LCD_ShowString(300,250,210,24,24,show);
            }
               
           }
           else delay_ms(10);
		t++;
		if((t%10)==0)LED0=!LED0;	
	}
}


void clear_point(u16 num)//更新显示屏当前列
{
	u16 index_clear_lie = 0; 
	u16 Y_init=lcddev.height-20;
	POINT_COLOR = DARKBLUE ;
	for(index_clear_lie = 0;index_clear_lie < lcddev.height;index_clear_lie++)
	{		
		if((num!=lcddev.width/2) && (index_clear_lie!=Y_init))
		LCD_DrawPoint(num,index_clear_lie);
	}
	if(!(num%40))//判断hang是否为50的倍数 画列点
	{
		for(index_clear_lie = 10;index_clear_lie <=lcddev.height;index_clear_lie += 10)
		{		
			LCD_Fast_DrawPoint(num ,index_clear_lie,WHITE );
		}
	}
	if(!(num%10))//判断hang是否为10的倍数 画行点
	{
		for(index_clear_lie = 40;index_clear_lie <=lcddev.height;index_clear_lie += 40)
		{		
			LCD_Fast_DrawPoint(num ,index_clear_lie,WHITE );
		}
	}	
	POINT_COLOR = YELLOW;	
}
void Collect_ADC_LEVEL(float *buff)
{
		u16 i = 0;
		for(i = 0;i < FFT_LENGTH;i++)//存储AD数值
	{
		buff[2*i] = Get_Adc(ADC_Channel_5);
	}
		for(i = 0;i < FFT_LENGTH;i++)//存储AD数值
	{
		buff[2*i] = buff[2*i]/4096*3.3f;
		buff[2*i+1]=0;
	}
}
void DrawOscillogram(float *buff)//画波形图
{
	static u16 Ypos1 = 0,Ypos2 = 0;
	u16 i = 0;
	u16 Y_init	=	20;
	POINT_COLOR = YELLOW;
    #if 0
	for(i = 0;i < lcddev.width;i++)
	{
		clear_point(i);	
		Ypos2 = lcddev.height - (Y_init+(u16)(buff[2*i]/3.3f*(lcddev.height-Y_init)));//转换坐标
		//Ypos2 = Ypos2 * bei;
		if(Ypos2 >lcddev.height)
			Ypos2 =lcddev.height; //超出范围不显示
		LCD_DrawLine (i ,Ypos1 , i+1 ,Ypos2);
		Ypos1 = Ypos2 ;
	}
    #endif
    	for(i = 0;i < lcddev.width/2;i++)
	{
		clear_point(i);	
		Ypos2 = lcddev.height - (Y_init+(u16)(buff[2*i]/3.3f*(lcddev.height-Y_init)));//转换坐标
		//Ypos2 = Ypos2 * bei;
		if(Ypos2 >lcddev.height)
			Ypos2 =lcddev.height; //超出范围不显示
		LCD_DrawLine (i ,Ypos1 , i+1 ,Ypos2);
		Ypos1 = Ypos2 ;
	}
    Ypos1 = 0;	
}
void Set_BackGround(void)
{
	POINT_COLOR = YELLOW;
    LCD_Clear(DARKBLUE);
	LCD_DrawRectangle(0,0,lcddev.width,lcddev.height);//矩形
	LCD_DrawLine(0,lcddev.height-20,lcddev.width,lcddev.height-20);//横线
	LCD_DrawLine(lcddev.width/2,0,lcddev.width/2,lcddev.height);//竖线
	POINT_COLOR = WHITE;
	BACK_COLOR = DARKBLUE;
	//LCD_ShowString(30,40,210,24,24,(u8*)"vpp=");	
}

void Lcd_DrawNetwork(void)
{
	u16 index_y = 0;
	u16 index_x = 0;	
	
    //画列点	
	for(index_x = 40;index_x < 480;index_x += 40)
	{
		for(index_y = 10;index_y < 320;index_y += 10)
		{
			LCD_Fast_DrawPoint(index_x,index_y,WHITE);	
		}
	}
	//画行点
	for(index_y = 40;index_y < 320;index_y += 40)
	{
		for(index_x = 10;index_x < 480;index_x += 10)
		{
			LCD_Fast_DrawPoint(index_x,index_y,WHITE);	
		}
	}
}

float get_vpp(float *buf)	   //获取峰峰值
{
	
	float max_data=buf[0];
	float min_data=buf[4];//buf[1];
	u32 n=0;
	float Vpp=0;
	for(n = 0;n<FFT_LENGTH;n++)
	{
		if(buf[2*n] > max_data)
		{
			max_data = buf[2*n];
		}
		if(buf[2*n] < min_data)
		{
			min_data = buf[2*n];
		}			
	} 	
	Vpp = max_data - min_data;
	return Vpp;	
}
void rDawSpectrum(float *buf,u32 f)
{
	u32 n;
	static u16 Ypos1 = 0,Ypos2 = 0;
	n=f/(10500000/492/1024);
	if(FFT_LENGTH-n<lcddev.width/2 && n>lcddev.width/2)
		for(n=n-lcddev.width/2;n<n+lcddev.width/2;n++)
	{
		clear_point(n);	
		Ypos2 = lcddev.height - (lcddev.height/2+(u16)(buf[2*n]/3.3f*lcddev.height/2));//转换坐标
		//Ypos2 = Ypos2 * bei;
		if(Ypos2 >lcddev.height)
			Ypos2 =lcddev.height; //超出范围不显示
		LCD_DrawLine (n ,Ypos1 , n+1 ,Ypos2);
		Ypos1 = Ypos2 ;
	}
		
}
u32 get_freq(float *buff)   //获取频率
{
	u32 n;
	float max_data=buff[1];
	u32 max_freq=1;
	for(n = 1;n<FFT_LENGTH/2 ;n++)
	{
		if(buff[n] > max_data)
		{
			max_data = buff[n];
			max_freq=n;
		}
	}
	max_freq=(u32)(max_freq*(10500000/492/1024)*51/50);
		return max_freq;
}

u32 get_arg(float *buffx,float *buffy)   //获取相位(能用)
{
	u32 n;
	float max_data=buffx[1];
	u32 max_arg=1;
	for(n = 1;n<FFT_LENGTH/2 ;n++)          //峰值
	{
		if(buffx[n] > max_data)
		{
			max_data = buffx[n];
			max_arg=n;
		}
	}
	max_arg=(u32)(atan2(buffy[max_arg*2],buffy[max_arg*2+1])*180/3.1415f);
		return max_arg;
}

void Add_Kwindow(float *buff)
{
	u16 i;
	for(i =0;i<FFT_LENGTH;i++)
	{
		buff[i]=buff[i]*kaiser[i];
	}
}

#if xiangweizhi
//获取峰值
int fft_getpeak(float *inputx,float *input,float *output,u16 inlen,u8 x,u8 N,float y) //  intlen 输入数组长度，x寻找长度
{                                                                           
	int i,i2;
	u32 idex;  //不同于上一个函数中的，因为他们在不同的函数中被定义
	float datas;
	float sum;
	int outlen=0;
	for(i=0;i<inlen-x;i+=x)
	{
		arm_max_f32(input+i,x,&datas,&idex);   
		if( (input[i+idex]>=input[i+idex+1])&&(input[i+idex]>=input[i+idex-1])&&( (2*datas)/FFT_LENGTH )>y)   
		   {
			   sum=0;   
			   for(i2=i+idex-N;i2<i+idex+N;i2++)   
			   {
				   sum+=input[i2];          
			   }        
			   if(1.5*sum/(2*N)<datas)       
			   {                                                                                             
				     output[3*outlen+2] = atan2(inputx[2*(i+idex+1)+1],inputx[2*(i+idex+1)])*180/3.1415926f;				   
				     output[3*outlen+1] = 1.0*(2*datas)/FFT_LENGTH;   //计算幅度
					 output[3*outlen] = 1.0*fft_sample_freq*(i+idex+1)/FFT_LENGTH;//计算频率
					 outlen++;				   
			   }                                                                                               
               else continue;			   
		   }
			
		else continue;
		
	}
	return outlen;	
}
#endif
